## meta-celestica/meta-ivystone/conf/layer.conf
```bitbake
# We have a conf and classes directory, add to BBPATH
BBPATH .= ":${LAYERDIR}"

# We have recipes-* directories, add to BBFILES
BBFILES += "${LAYERDIR}/recipes-*/*/*.bb \
	${LAYERDIR}/recipes-*/*/*.bbappend"

BBFILE_COLLECTIONS += "ivystone"
BBFILE_PATTERN_ivystone = "^${LAYERDIR}/"
BBFILE_PRIORITY_ivystone = "22"
```

## meta-celestica/meta-mystone/conf/layer.conf
```bitbake
# We have a conf and classes directory, add to BBPATH
BBPATH .= ":${LAYERDIR}"

# We have recipes-* directories, add to BBFILES
BBFILES += "${LAYERDIR}/recipes-*/*/*.bb \
	${LAYERDIR}/recipes-*/*/*.bbappend"

BBFILE_COLLECTIONS += "mystone"
BBFILE_PATTERN_mystone = "^${LAYERDIR}/"
BBFILE_PRIORITY_mystone = "22"
```

## meta-celestica/meta-r3187-cl/conf/layer.conf
```bitbake
# We have a conf and classes directory, add to BBPATH
BBPATH .= ":${LAYERDIR}"

# We have recipes-* directories, add to BBFILES
BBFILES += "${LAYERDIR}/recipes-*/*/*.bb \
	${LAYERDIR}/recipes-*/*/*.bbappend"

BBFILE_COLLECTIONS += "r3187-cl"
BBFILE_PATTERN_r3187-cl = "^${LAYERDIR}/"
BBFILE_PRIORITY_r3187-cl = "22"
```

## meta-celestica/meta-r3187-cl/conf/local.conf.sample
```bitbake
#
# Local configuration file for building the OpenBMC image.
#

# Machine Selection
MACHINE ??= "r3187-cl"

# OpenBMC distro settings
DISTRO ?= "openbmc-fb"

DEFAULT_TIMEZONE = "Asia/Shanghai"
```

## meta-celestica/meta-r3187-cl/conf/machine/r3187-cl.conf
```bitbake
#@TYPE: Machine
#@NAME: r3187-cl
#@DESCRIPTION: Machine configuration for Celestica r3187-cl

require conf/machine/include/ast2520.inc

UBOOT_MACHINE_r3187-cl = "cel_as58xx-cl_config"

PREFERRED_VERSION_u-boot = "v2016.07"
PREFERRED_VERSION_u-boot-mkimage = "v2016.07"
PREFERRED_VERSION_u-boot-fw-utils = "v2016.07"

PREFERRED_VERSION_libipmi = "0.1"
PREFERRED_VERSION_ipmid = "0.1"
PREFERRED_VERSION_rest-api = "0.1"
PREFERRED_VERSION_at93cx6-util = "0.1"
PREFERRED_VERSION_bcm5396-util = "0.1"

MACHINE_ESSENTIAL_EXTRA_RDEPENDS += "           \
    kernel-module-i2c                           \
    kernel-module-cpld                           \
    "
```

## meta-celestica/meta-seastone2f/conf/layer.conf
```bitbake
# We have a conf and classes directory, add to BBPATH
BBPATH .= ":${LAYERDIR}"

# We have recipes-* directories, add to BBFILES
BBFILES += "${LAYERDIR}/recipes-*/*/*.bb \
	${LAYERDIR}/recipes-*/*/*.bbappend"

BBFILE_COLLECTIONS += "seastone2f"
BBFILE_PATTERN_seastone2f = "^${LAYERDIR}/"
BBFILE_PRIORITY_seastone2f = "22"
```

## meta-celestica/meta-seastone2f/conf/local.conf.sample
```bitbake
#
# Local configuration file for building the OpenBMC image.
#

# Machine Selection
MACHINE ??= "seastone2f"

# OpenBMC distro settings
DISTRO ?= "openbmc-fb"

DEFAULT_TIMEZONE = "Asia/Shanghai"
```
